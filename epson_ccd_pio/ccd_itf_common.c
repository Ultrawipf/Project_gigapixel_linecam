#include "ccd_itf_common.h"
#include "ccd_constants.h" // Define in subproject
#include <stdio.h>
#ifdef PIOLIB
#include "piolib.h"
#include <wiringPi.h>
#else
// Else pico

// #include "ccd_commands.h"
//#include "pio.h"
#endif
#include "pio_ccd.pio.h"

#define  MAX( a, b ) ( ( a > b) ? a : b )
#define  MIN( a, b ) ( ( a < b) ? a : b )

#define TRANSFERSIZE 62000 // One line 122400 + a bit more dummy data
#define DATA_BIT_DELAY_US 10
// #define CTRL_LSBFIRST

#ifdef PIOLIB
// Pi5 has different gpio calls
void gpio_put(uint32_t pin, bool state){
    digitalWrite(pin, state);
}

bool gpio_get(uint32_t pin){
    return digitalRead(pin);
}
#endif

#ifndef PIODATACLOCK 
#define PIODATACLOCK 60000000.0f
#endif

// Constants
// Startup commands sampled from scanner before first calibration sampling
// First block. Setup and constants
// const uint32_t startcommands[] = {0x7F400B,0x70000F,0x618000,0x69FFF0,0x680100,0x6A0000,0x620886,0x788007,0x798007,0x7A8007,0x7E00BC,0x440000,0x450000,0x460000,0x470000,0x580000,0x590000,0x5A0000,0x5B0000,0x5C0000,0x640000,0x650000,0x660000,0x72CC00,0x6F0000};
// // Second block
// const uint32_t startcommands2[] = {0x68FFFF,0x62020E,0x600080,0x6202CE,0x6200C6,0x620886,0x6A0000,0x62020E,0x600080,0x6202CE,0x6200C6,0x620886};
// // Before sampling starts
// const uint32_t startcommands3[] = {0x680100,0x62020E,0x600080,0x6202CE,0x6200C6,0x620886,0x630001,0x00C0FF,0x01C0FF,0x02C0FF,0x03C0FF,0x04C0FF,0x05C0FF,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0x620886,0x630002};
// const uint32_t register_settings[] = {0x000000,0x010000,0x020028,0x0331C0,0x0400C8,0x0531C0,0x0600F0,0x071000,0x08FFFF,0x09FFFF,0x0AFFFF,0x0BFFFF,0x0CFFFF,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0x3EFFFF,0x3FFFFF};
// const uint32_t startcommands4[] = {0x630000,0x62020E,0x600080,0x6202CE,0x6200C6,0x620886};

// // Sent before every scan and after almost every command
// const uint32_t block1[] = {0x62020E,0x600080,0x6202CE,0x6200C6,0x620886};
// // Sent between sampling sections.
// const uint32_t block2[] = {0x680100,0x62020E,0x600080,0x6202CE,0x6200C6,0x620886};
// // Resolutions
// const uint32_t setupCmds_300dpi[]  =  {0x630001,0x00C0FF,0x01C0FF,0x02C0FF,0x03C0FF,0x04C0FF,0x05C0FF,0x06C0F0,0x07C000,0x08C000,0x09C000,0x0AC000,0x0BC000,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0x6200C6,0x620886};
// const uint32_t setupCmds_600dpi[]  =  {0x630001,0x00C0FF,0x01C0FF,0x02C0FF,0x03C0FF,0x04C0FF,0x05C0FF,0x06C0FF,0x07C0FF,0x08C0FF,0x09C0FF,0x0AC0FF,0x0BC0F0,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0x6200C6,0x620886};
// const uint32_t setupCmds_1200dpi[] =  {0x630001,0x00C0FF,0x01C0FF,0x02C0FF,0x03C0FF,0x04C0FF,0x05C0FF,0x06C0FF,0x07C0FF,0x08C0FF,0x09C0FF,0x0AC0FF,0x0BC0FF,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0x6200C6,0x620886};
// const uint32_t setupCmds_2400dpi[] =  {0x630001,0x00C5F5,0x01C5F5,0x02C5F5,0x03C5F5,0x04C5F5,0x05C5F5,0x06C5F5,0x07C5F5,0x08C5F5,0x09C5F5,0x0AC5F5,0x0BC5F5,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0x6200C6,0x620886};
// const uint32_t setupCmds_4800dpi[] =  {0x630001,0x00A6A6,0x01A6A6,0x02A6A6,0x03A6A6,0x04A6A6,0x05A6A6,0x06A6A6,0x07A6A6,0x08A6A6,0x09A6A6,0x0AA6A6,0x0BA6A6,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0x6200C6,0x620886};


int set_clock(const SM_def *smdef,int enable){
    if(smdef->sm == 255){
        return 0;
    }
    if(enable){
        pio_sm_set_enabled(smdef->pio, smdef->sm, true); // Enable SM
        gpio_put(RESETPIN, true); // Disable reset
        return 1;
    }else{
        pio_sm_set_enabled(smdef->pio, smdef->sm, false); // Disable SM
        pio_sm_set_pins(smdef->pio, smdef->sm, 0);  // Disable pins
        gpio_put(RESETPIN, false); // Hold under reset when clock off
        return 1;
    }
}


bool setup_clock(SM_def *smdef,float freq, uint gpio){
    // uint gpio = 4;
    smdef->sm = pio_claim_unused_sm(smdef->pio, true);

    smdef->offset = pio_add_program(smdef->pio, &ccdclock_program);
    // printf("Loaded ccd clock at %d, using sm %d, gpio %d\n", smdef->offset, smdef->sm, gpio);

    pio_sm_clear_fifos(smdef->pio, smdef->offset);

    ccdclock_program_init(smdef->pio, smdef->sm, smdef->offset, gpio, freq); // Generate 6MHz clock 6000000.0
    //gpio_set_drive_strength(gpio,GPIO_DRIVE_STRENGTH_8MA); // Tune clock
    return true;
}

bool setup_data(SM_def *smdef,uint gpiobase){

    if(smdef->sm == SMDEF_INVALID_VAL){
        smdef->sm = pio_claim_unused_sm(smdef->pio, true);
    }
    #ifdef PIOLIB
    pio_sm_config_xfer(smdef->pio, smdef->sm, PIO_DIR_FROM_SM, TRANSFERSIZE*4, 2);
    #endif
    if(smdef->offset == SMDEF_INVALID_VAL){
        smdef->offset = pio_add_program(smdef->pio, &ccddata_program);
    }
    
    // printf("Loaded ccd data at %d, using sm %d, gpio %d\n", smdef->offset, smdef->sm, gpiobase);
    ccddata_program_init(smdef->pio, smdef->sm, smdef->offset, gpiobase, PIODATACLOCK); // 60000000
    if(ACLKPIN != gpiobase+8){ // If clock out is not the same pin as clock in initialize clock in here
        pio_gpio_init(smdef->pio, gpiobase+8);
    }
    
    pio_sm_clear_fifos(smdef->pio, smdef->sm);
    return true;
}

uint32_t readData(const SM_def *smdef, uint32_t* buf,int samples){
    // Maybe clear buffer, reset and wait for TG using exec command?
    if(smdef->sm == SMDEF_INVALID_VAL){
        return 0;
    }
    
    uint32_t ret = 0;
    int ofs = 0;
    uint32_t curlen = 1;
    // printf("Waiting for %d samples\n",samples);
    while(ofs < samples){
        #ifdef PIOLIB
        curlen = MIN(samples-ofs,TRANSFERSIZE);
        ret = pio_sm_xfer_data(smdef->pio, smdef->sm, PIO_DIR_FROM_SM, curlen*sizeof(uint32_t), buf+ofs);
        if(ret){
            printf("pio sm xfer err %d\n",ret);
        }
        #else
        buf[ofs] = pio_sm_get_blocking(smdef->pio, smdef->sm);
        #endif
        ofs += curlen;
    }
    
    // pio_sm_set_enabled(pio, sm_data, false); // Disable SM
    if(ret){
        // printf("Transfer failed %d\n",ret);
        return 0;
    }
    return ofs;
}

void begin_ctrl_data_transfer(const SM_def *smdef,uint32_t basepin){
    pio_sm_set_enabled(smdef->pio,smdef->sm,false); // Turn off SM
    pio_sm_set_consecutive_pindirs(smdef->pio, smdef->sm, basepin+6, 2, true); // Set pins to output
    pio_sm_exec(smdef->pio, smdef->sm, (PIOSETINST | 0)); // Clock low
    sleep_us(100);
    gpio_put(CSPIN, false); // Assert CS
    sleep_us(100);
}

void end_ctrl_data_transfer(const SM_def *smdef,uint32_t basepin){
    pio_sm_exec(smdef->pio, smdef->sm, (PIOSETINST | 0)); // Both low
    pio_sm_set_consecutive_pindirs(smdef->pio, smdef->sm, basepin+6, 2, false); // Set pindirs back
    gpio_put(CSPIN, true); // Release CS
    sleep_us(DATA_BIT_DELAY_US*2);
}


/**
 * @brief Reads a 16b value via the DIO data interface
 * 
 * @param cmd Command/Register address, 0x80 R/W bit will be set
 * @return uint16_t Register contents
 */
uint16_t read_ctrl_data_sm(const SM_def *smdef,uint8_t cmd){
    const uint basepin = DATABASEPIN;
    uint16_t buf = 0;
    cmd |= 0x80; // Set read bit
    begin_ctrl_data_transfer(smdef,basepin);
    for(uint32_t count = 0; count < 8; count++){
        uint8_t curbit = (cmd >> (7-count) ) & 0x01; // Shift MSB
        pio_sm_exec(smdef->pio, smdef->sm, (PIOSETINST | curbit)); // Clock low
        sleep_us(DATA_BIT_DELAY_US);
        pio_sm_exec(smdef->pio, smdef->sm, (PIOSETINST | 2 | curbit)); // Clock high
        sleep_us(DATA_BIT_DELAY_US);
    }
    pio_sm_set_consecutive_pindirs(smdef->pio, smdef->sm, basepin+6, 1, false); // Set data to input
    for(uint32_t count = 0; count < 16; count++){
        // uint8_t curbit = (cmd >> (7-count) ) & 0x01; // Shift MSB
        pio_sm_exec(smdef->pio, smdef->sm, (PIOSETINST | 0)); // Clock low
        sleep_us(DATA_BIT_DELAY_US);
        pio_sm_exec(smdef->pio, smdef->sm, (PIOSETINST | 2)); // Clock high
        bool dstate = gpio_get(basepin+6);
        if(dstate){
            buf |= 1 << (15-count);
        }
        sleep_us(DATA_BIT_DELAY_US);
    }
    end_ctrl_data_transfer(smdef,basepin);
    return buf;
}

/*
Abused data state machine to send control data in software. Speed is very slow so this is fine
Requires D6 and D7 to be set as SET pins
*/
void send_ctrl_data_sm_32(const SM_def *smdef,uint32_t buf){
    const uint basepin = DATABASEPIN;
    if(buf & 0x80000000){
        return; // Reject if read bit is set. Use read function instead
    }
    begin_ctrl_data_transfer(smdef,basepin);
    
    for(uint32_t count = 0; count < 24; count++){
        #ifdef CTRL_LSBFIRST
        uint8_t curbit = (buf >> (count) ) & 0x01; // Shift
        #else
        uint8_t curbit = (buf >> (23-count) ) & 0x01; // Shift MSB
        #endif
        pio_sm_exec(smdef->pio, smdef->sm, (PIOSETINST | 0 |curbit)); // Clock low
        sleep_us(DATA_BIT_DELAY_US);
        pio_sm_exec(smdef->pio, smdef->sm, (PIOSETINST | 2 | curbit)); // Clock high
        sleep_us(DATA_BIT_DELAY_US);
    }
    end_ctrl_data_transfer(smdef,basepin);
}
void send_ctrl_data_sm(const SM_def *sm_data,uint8_t cmd,uint8_t data1,uint8_t data2){
    uint32_t buf = (cmd << 16) | (data1<<8) | data2;
    send_ctrl_data_sm_32(sm_data,buf);
}

void send_ctrl_data_arr(const SM_def *sm_data,const uint32_t* buf,uint32_t len){
    for(uint32_t i = 0; i<len; i++){
        send_ctrl_data_sm_32(sm_data,buf[i]);
    }
}

/*Starts outputting frame data*/
void start_sampling(const SM_def *sm_data){
    // printf("Start sampling\n");
    pio_sm_clear_fifos(sm_data->pio, sm_data->sm);
    send_ctrl_data_arr(sm_data,block2,sizeof(block2)/sizeof(uint32_t)); // Seems to be sent before sampling starts
    send_ctrl_data_sm_32(sm_data,0x600081); // Start sampling
    // pio_sm_clkdiv_restart(sm_data.pio,sm_data.sm);
    pio_sm_set_enabled(sm_data->pio, sm_data->sm,true); // Turn on SM
}
/*Stops outputting frame data*/
void stop_sampling(const SM_def *sm_data){
    pio_sm_set_enabled(sm_data->pio, sm_data->sm,false); // Turn off SM
    send_ctrl_data_sm_32(sm_data,0x600080); // Stop sampling
    // printf("Stopped sampling\n");
}

/**
 * @brief Changes the line resolution
 * 
 * @param resPreset Resolution preset identifier
 */
void set_resolution(const SM_def *sm_data,CCD_Resolution_t resPreset){

    switch(resPreset){
        case CCD_Res_Full: // Main+Sub x2
        send_ctrl_data_arr(sm_data,setupCmds_4800dpi,sizeof(setupCmds_4800dpi)/sizeof(uint32_t));// Set 4800
        return; // Full width valid
        case CCD_Res_div2: // Main+Sub x1
        send_ctrl_data_arr(sm_data,setupCmds_2400dpi,sizeof(setupCmds_2400dpi)/sizeof(uint32_t));// Set 2400
        return;
        case CCD_Res_div4: // Main only
        send_ctrl_data_arr(sm_data,setupCmds_1200dpi,sizeof(setupCmds_1200dpi)/sizeof(uint32_t));// Set 1200
        return;
        case CCD_Res_div8: // Main w. skip
        send_ctrl_data_arr(sm_data,setupCmds_600dpi,sizeof(setupCmds_600dpi)/sizeof(uint32_t));// Set 600
        return;
        case CCD_Res_div16: // Mainw. skip
        send_ctrl_data_arr(sm_data,setupCmds_300dpi,sizeof(setupCmds_300dpi)/sizeof(uint32_t));// Set 300
        return;
    }
}

/*
Read a lot of data and set TG pulse after each linelength interval
*/
int readFrames(const SM_def *sm_data,uint32_t* buf,int samples,int linelength){
    int pos = 0;
    //printf("Reading frames %d tg each %d\n",samples,linelength);
    //pio_sm_clear_fifos(sm_data->pio,sm_data->sm);

    //pio_sm_restart(sm_data->pio,sm_data->sm);
    //pio_sm_set_enabled(sm_data.pio,sm_data->sm, true); // Enable SM
    // pio_sm_set_enabled(sm_data.pio,sm_data.sm, true); // Enable SM

    while(pos < samples){
        uint32_t read = 0;
        //int32_t nextTg = linelength; //  * (1+(pos/linelength))

        //pio_sm_restart(sm_data->pio,sm_data->sm); // Will wait for TG

        pio_sm_set_enabled(sm_data->pio,sm_data->sm, false); // Disable SM
        pio_sm_clear_fifos(sm_data->pio,sm_data->sm);
        pio_sm_exec(sm_data->pio, sm_data->sm, (0x0000 | sm_data->offset )); // Reset
        pio_sm_set_enabled(sm_data->pio,sm_data->sm, true); // Enable SM
        //pio_sm_exec(sm_data->pio, sm_data->sm,0x3fa9);
        //pio_sm_drain_tx_fifo(sm_data->pio,sm_data->sm);
        //gpio_put(TGPIN, true);
        //pio_sm_exec(sm_data->pio, sm_data->sm, (PIOSETINST | 0x0f00 | 0x08)); // TG high + 15 cycle wait
        //pos += readData(sm_data,buf+pos,12); // Maybe clear buffer and do blocking read?
        //?pio_sm_drain_tx_fifo(sm_data->pio,sm_data->sm);
        //pio_sm_clear_fifos(sm_data->pio,sm_data->sm);
        //gpio_put(TGPIN, false);

        //pio_sm_exec(sm_data->pio, sm_data->sm, (PIOSETINST | 0)); // TG low
        read = readData(sm_data,buf+pos,MIN(linelength,samples-pos));
        if(read){
            pos+=read;
        }else{
            return 0;
        }
    }
    return pos;
}

/*
int readFrames(const SM_def *sm_data,uint32_t* buf,int samples,uint32_t linelength){
    uint32_t pos = 0;
    uint32_t read = 0;
    printf("Reading frames %d tg each %d\n",samples,linelength);
    //pio_sm_clear_fifos(sm_data->pio,sm_data->sm);
    pio_sm_set_enabled(sm_data->pio,sm_data->sm, true); // Enable SM
    //pio_sm_restart(sm_data->pio,sm_data->sm);
    //pio_sm_set_enabled(sm_data.pio,sm_data->sm, true); // Enable SM
    // pio_sm_set_enabled(sm_data.pio,sm_data.sm, true); // Enable SM
    //pio_sm_exec(sm_data->pio, sm_data->sm, (0x1f00 | 0x00)); // Reset
    pio_sm_clear_fifos(sm_data->pio,sm_data->sm);
    pio_sm_exec(sm_data->pio, sm_data->sm, (PIOSETINST | 0x0f00 | 0x08)); // TG high
    //pos += readData(sm_data,buf+pos,12); // Maybe clear buffer and do blocking read?
    pio_sm_exec(sm_data->pio, sm_data->sm, (PIOSETINST | 0)); // TG low
    read = readData(sm_data,buf+pos,MIN(linelength,samples-pos));
    if(read){
        pos+=read;
    }else{
        return 0;
    }

    return pos;
}
*/

/**
 * @brief Set the rgb gain ofs object
 * 
 * @param rOfs Red offset. 0x80 default
 * @param gOfs Green offset. 0x80 default
 * @param bOfs Blue offset. 0x80 default
 * @param rGain Red gain 6b
 * @param gGain Green gain 6b
 * @param bGain Blue gain 6b
 */
void set_rgb_gain_ofs(const SM_def *sm_data,uint8_t rOfs,uint8_t gOfs,uint8_t bOfs,uint8_t rGain,uint8_t gGain,uint8_t bGain){
    uint32_t dat = 0x780000;
    dat |= (rOfs & 0xff) << 8;
    dat |= (rGain & 0x3f);
    send_ctrl_data_sm_32(sm_data,dat);
    send_ctrl_data_arr(sm_data,block1,sizeof(block1)/sizeof(uint32_t));
    dat = 0x790000;
    dat |= (gOfs & 0xff) << 8;
    dat |= (gGain & 0x3f);
    send_ctrl_data_sm_32(sm_data,dat);
    send_ctrl_data_arr(sm_data,block1,sizeof(block1)/sizeof(uint32_t));
    dat = 0x7A0000;
    dat |= (bOfs & 0xff) << 8;
    dat |= (bGain & 0x3f);
    send_ctrl_data_sm_32(sm_data,dat);
    send_ctrl_data_arr(sm_data,block1,sizeof(block1)/sizeof(uint32_t));
}
